## main/Kconfig
```kconfig
menu "Photoframe optional features"

    comment "Every feature is opt-in. With all of them off the firmware matches upstream."
    comment "Select them with build.py (--with <feature> / --all-features), not by hand."

    # ---- Hardware capabilities, derived from the board selection ------------
    # Kept in sync with boards/boards.json and the BOARD_HAL_HAS_* macros by
    # scripts/check_capabilities.py.

    config FORK_HW_SPEAKER
        bool
        default y if BOARD_DRIVER_WAVESHARE_PHOTOPAINTER_73

    config FORK_HW_MICROPHONE
        bool
        default y if BOARD_DRIVER_WAVESHARE_PHOTOPAINTER_73

    config FORK_HW_CLIMATE_SENSOR
        bool
        default y if SENSOR_DRIVER_SHTC3 || SENSOR_DRIVER_SHT40 || SENSOR_DRIVER_SHT3X

    # ---- Shared building blocks, selected by the features that need them ----

    config FORK_HTTP_FETCH
        bool

    config FORK_EXIF
        bool

    config FORK_WEATHER
        bool
        select FORK_HTTP_FETCH

    config FORK_CLIMATE_CORE
        bool

    config FORK_IMAGE_PIPELINE
        bool

    config FORK_AUDIO_HAL
        bool

    config FORK_OTA_REPO
        string "GitHub repository that OTA updates are fetched from (owner/name)"
        default "t3stier/esp32-photoframe-rebuild"
        help
            The release feed the firmware checks for updates. Defaults to this
            project's own repository (the GitHub fork t3stier/esp32-photoframe-rebuild;
            t3ste/esp32-photoframe-rebuild is a mirror of it), which publishes its own
            releases; pass
            build.py --ota-repo owner/name to point a build at another feed
            (e.g. the upstream project itself, or during development).
            A build with optional features that updates itself from the upstream
            feed is replaced by the plain upstream firmware: point this at a feed
            with matching binaries, or switch the automatic update check off.

    # ---- Features -----------------------------------------------------------

    config FEATURE_TELEGRAM
        bool "Telegram bot photo rotation"
        default n
        select FORK_EXIF
        select FORK_IMAGE_PIPELINE
        help
            Receive photos through a Telegram bot, remote commands, orientation
            pairing and on-device EPDGZ conversion.

    config FEATURE_OVERLAYS
        bool "Weather and headline overlays"
        default n
        select FORK_HTTP_FETCH
        select FORK_WEATHER
        select FORK_CLIMATE_CORE
        select FORK_EXIF
        select FORK_IMAGE_PIPELINE
        help
            Weather forecast and news headline bars, photo captions and a
            low-battery badge drawn on the display.

    config FEATURE_AGENDA
        bool "Agenda mode (ToDo and calendars)"
        default n
        select FORK_HTTP_FETCH
        select FORK_WEATHER
        select FORK_CLIMATE_CORE
        select FORK_IMAGE_PIPELINE
        help
            Full-screen ToDo list and calendar views (ICS sources A-E with
            recurrence rules), 7-day grid and colour profiles.

    config FEATURE_CHIMES
        bool "Chimes (speaker feedback)"
        default n
        depends on FORK_HW_SPEAKER
        select FORK_AUDIO_HAL
        help
            Short beeps for firmware events. Needs a board with a speaker.

    config FEATURE_CLIMATE
        bool "Climate sensor readout and history"
        default n
        depends on FORK_HW_CLIMATE_SENSOR
        select FORK_CLIMATE_CORE
        select FORK_IMAGE_PIPELINE
        help
            Temperature and humidity badges, Agenda chip and history chart.
            Needs a board with a temperature/humidity sensor.

    config FEATURE_ALARMCLOCK
        bool "Bedside alarm clock"
        default n
        depends on FORK_HW_SPEAKER
        select FORK_AUDIO_HAL
        help
            Configurable alarm schedule that wakes the device and rings through
            the speaker without bringing up WiFi. Needs a board with a speaker.

    config FEATURE_VOICE_STOP
        bool "Stop the alarm with a spoken word"
        default n
        depends on FEATURE_ALARMCLOCK && FORK_HW_SPEAKER && FORK_HW_MICROPHONE
        help
            Keyword spotting on the onboard microphone, plus the microphone
            level meter and speaker self-test tools. Needs the alarm clock and
            a board with speaker and microphone.

    config FEATURE_BATTERY_HISTORY
        bool "Battery history"
        default n
        help
            Battery voltage log with a chart and a days-remaining estimate.

    config FEATURE_DISPLAY_HISTORY
        bool "Display history (no-repeat random rotation)"
        default n
        help
            Random rotation shows every image once before repeating.

    config FEATURE_HTTPS
        bool "HTTPS web UI"
        default n
        help
            Second, TLS-encrypted web server on port 443 with an on-device
            self-signed certificate. Plain HTTP on port 80 keeps working.

    config FEATURE_OFFLINE_HOTSPOT
        bool "Offline mode and on-demand hotspot"
        default n
        help
            Set the device up without a WiFi network and start an access point
            with the full web UI on demand (hold BOOT for 3 seconds).

    config FEATURE_ERROR_BANNER
        bool "On-display error banner"
        default n
        select FORK_IMAGE_PIPELINE
        help
            Shows WiFi and internet failures as a banner on the display.

    config FEATURE_OTA_CHANNEL
        bool "OTA release channel and firmware variant"
        default n
        help
            Choose between stable and pre-release updates and between the
            firmware variants offered by the release.

    config FEATURE_WIFI_RESILIENCE
        bool "WiFi resilience options"
        default n
        help
            Keep the saved WiFi credentials over transient connection failures
            (extended retry, reprovisioning switch), cap the TX power while a
            battery is connected, and choose the WiFi performance mode.

    config FEATURE_FACECROP
        bool "Face-aware crop variants"
        default n
        select FORK_IMAGE_PIPELINE
        help
            Uses face-crop sidecar files and pre-rendered Cover/Fit variants
            produced by process-cli.

    config FEATURE_WEBCAL
        bool "webcal:// subscription links"
        default n
        depends on FEATURE_AGENDA
        help
            Accepts webcal:// (and webcals://) subscription links for the
            Agenda calendars and fetches them over https://, the way calendar
            apps hand them out. Needs the Agenda feature.

    config FEATURE_SOURCE_AUTH
        bool "Login in the calendar and ToDo URLs"
        default n
        depends on FEATURE_AGENDA
        help
            A calendar or ToDo URL may carry a login,
            https://user:password@host/path, which the frame answers a
            server's 401 with (HTTP Basic or Digest). The URL fields stay
            write-only. Over plain http:// the login is only sent when a
            setting allows it. Needs the Agenda feature.

    config FEATURE_CALDAV
        bool "CalDAV calendars"
        default n
        depends on FEATURE_SOURCE_AUTH
        help
            A calendar address written caldavs://user:password@host/path (or
            caldav:// for plain http) is queried with a CalDAV REPORT: the
            server sends only the events of the coming days and expands
            repeating events itself, instead of the frame downloading the whole
            calendar. Needs the source-auth feature (and through it Agenda).

    config FEATURE_CALDAV_TODO
        bool "CalDAV task lists"
        default n
        depends on FEATURE_CALDAV
        help
            A caldavs://user:password@host/path address in the Agenda's ToDo
            field is read as a CalDAV task list: its open to-dos (VTODO) show
            up in the ToDo column with their priority and due date. Needs
            the caldav feature.

    config FEATURE_INFO_SCREENS
        bool "Information screens in the Agenda rotation"
        default n
        depends on FEATURE_AGENDA && FEATURE_GLYPHS
        help
            Full-screen pages besides the Agenda that take turns with it on
            the Agenda's schedule. This is only the base (drawing primitives,
            the rotation, the settings); the pages come with their own
            options, such as the chore wheel. Needs the Agenda and the glyphs
            (real umlauts) options.

    config FEATURE_CHORE_WHEEL
        bool "Chore wheel screen"
        default n
        depends on FEATURE_INFO_SCREENS
        help
            A page with a donut wheel and one card per chore: who does what
            this week, and next week. The chores go round the members by ISO
            week. Needs the information screens option.

    config FEATURE_WEATHER_SCREEN
        bool "Weather screen"
        default n
        depends on FEATURE_INFO_SCREENS && FEATURE_OVERLAYS
        help
            A page with today's weather as a big icon and temperature and
            the next four days as rows. It uses the weather place and
            provider of the overlays option. Needs the information screens
            option and the overlays option.

    config FEATURE_FACT_OF_THE_DAY
        bool "Fact-of-the-day screen"
        default n
        depends on FEATURE_INFO_SCREENS
        help
            A page with one fact a day: 24 built-in facts in English and
            German, or your own list (a text file in the storage, edited in
            the Web UI). Needs the information screens option.

    config FEATURE_FINANCE_SNAPSHOT
        bool "Exchange-rate screen"
        default n
        depends on FEATURE_INFO_SCREENS
        help
            A page with the ECB reference rates of up to four currencies
            against the euro: the rate in big digits, the change against the
            day before and a sparkline of the last 30 working days. Free
            and without a key. Needs the information screens option.

    config FEATURE_UPLOAD_DEDUP
        bool "Duplicate detection at upload"
        default n
        help
            Every album keeps a small index of the MD5 of its images. An
            upload that is already in the album is refused (or stored with a
            warning) - by the file bytes, or by the decoded pixels so that the
            same picture from two browsers still counts. Images that were
            there before can be indexed in the background, and a report lists
            the duplicates of an album. Needs storage (SD card or flash).

    config FEATURE_GLYPHS
        bool "Real glyphs for umlauts, sharp s, degree and euro"
        default n
        select FORK_IMAGE_PIPELINE
        help
            The 17x24 bitmap font of the display text has ASCII only, so
            "Käse" is drawn "Kaese" and the degree and euro signs are lost.
            With this option ä ö ü Ä Ö Ü ß ° € are drawn as themselves, in
            overlay captions, headlines, the Agenda and Telegram captions. It
            only changes text that is drawn by another feature.

    config FEATURE_MULTI_UPLOAD
        bool "Upload several images at once"
        default n
        help
            The Web UI's upload takes a whole selection of files: photos are
            converted with the current settings one after the other, and
            pre-rendered EPDGZ/PNG files (for instance from process-cli) are
            uploaded as they are. The upload endpoint accepts an image
            without a thumbnail.

    config FORK_FIXES
        bool "General fixes and robustness improvements"
        default n
        select FORK_HTTP_FETCH
        help
            Bug fixes and hardening that go beyond upstream and are not tied
            to a single feature.

endmenu
```
